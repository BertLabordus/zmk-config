#include <behaviors.dtsi>
#include <dt-bindings/zmk/bt.h>
#include <dt-bindings/zmk/keys.h>
#include <dt-bindings/zmk/outputs.h>

#define U_BASE   0
#define U_NAV    1
#define U_MEDIA  2
#define U_NUM    3
#define U_SYM    4
#define U_FUN    5
#define U_MOUSE  6 //nvt
#define U_BUTTON 7 //nvt
#define U_EXTRA  8 //nvt
#define U_TAP    9 //nvt

#define U_MT(MOD, TAP) &u_mt MOD TAP
#define U_LT(LAYER, TAP) &u_lt LAYER TAP

#define U_NP &none // key is not present
#define U_NA &none // present but not available for use
#define U_NU &none // available but not used

// https://github.com/manna-harbour/miryoku_zmk/blob/559aa4beae75cb3206ab411b7da2adb9665c6896/miryoku/miryoku_clipboard.h#L7
#define U_RDO &kp LC(Y)
#define U_PST &kp LC(V)
#define U_CPY &kp LC(C)
#define U_CUT &kp LC(X)
#define U_UND &kp LC(Z)

#define U_BOOT &u_bootloader

#define U_TAPPING_TERM 200

#define U_MACRO(name,...) \
/ { \
  macros { \
    name: name { \
      compatible = "zmk,behavior-macro"; \
      #binding-cells = <0>; \
      __VA_ARGS__ \
    }; \
  }; \
};

#define MIRYOKU_SHIFT_FUNCTION(NAME, BINDING, SHIFT_BINDING) \
/ { \
  behaviors { \
    NAME: NAME { \
      compatible = "zmk,behavior-mod-morph"; \
      #binding-cells = <0>; \
      bindings = <BINDING>, <SHIFT_BINDING>; \
      mods = <(MOD_LSFT|MOD_RSFT)>; \
    }; \
  }; \
};

#define MIRYOKU_DOUBLE_TAP_GUARD(NAME, BINDING) \
/ { \
  behaviors { \
    NAME: NAME { \
      compatible = "zmk,behavior-tap-dance"; \
      #binding-cells = <0>; \
      tapping-term-ms = <U_TAPPING_TERM>; \
      bindings = <&none>, <BINDING>; \
    }; \
  }; \
};

// Combineer een marco en shift behavior functie
// In dit geval handig voor het koppelen en loskoppelen van bleutooth apparaten (e.g. normaal: <&bt BT_SEL 3> en met shift: <&u_macro_u_bt_sel_3>)
#define MIRYOKU_SHIFT_MACRO(NAME, BINDING, SHIFT_BINDING) \
U_MACRO(u_macro_ ## NAME, wait-ms = <0>; bindings = <SHIFT_BINDING>;) \
MIRYOKU_SHIFT_FUNCTION(NAME, BINDING, &u_macro_ ## NAME)

MIRYOKU_SHIFT_MACRO(u_bt_sel_0, &bt BT_SEL 0, &bt BT_SEL 0 &bt BT_CLR)
MIRYOKU_SHIFT_MACRO(u_bt_sel_1, &bt BT_SEL 1, &bt BT_SEL 1 &bt BT_CLR)
MIRYOKU_SHIFT_MACRO(u_bt_sel_2, &bt BT_SEL 2, &bt BT_SEL 2 &bt BT_CLR)
MIRYOKU_SHIFT_MACRO(u_bt_sel_3, &bt BT_SEL 3, &bt BT_SEL 3 &bt BT_CLR)

MIRYOKU_SHIFT_FUNCTION(u_caps_word, &caps_word, &kp CAPS)
MIRYOKU_SHIFT_FUNCTION(u_out_tog, &out OUT_TOG, &out OUT_USB)

MIRYOKU_DOUBLE_TAP_GUARD(u_bootloader, &bootloader)

&kscan0 { debounce-period = <20>; };

/ {
    behaviors {
        u_mt: u_mt {
          compatible = "zmk,behavior-hold-tap";
          #binding-cells = <2>;
          tapping-term-ms = <U_TAPPING_TERM>;
          flavor = "tap-preferred";
          bindings = <&kp>, <&kp>;
        };
        u_lt: u_lt {
          compatible = "zmk,behavior-hold-tap";
          #binding-cells = <2>;
          tapping-term-ms = <U_TAPPING_TERM>;
          flavor = "tap-preferred";
          bindings = <&mo>, <&kp>;
        };
    };
};

// Hier staan de layers
// https://github.com/manna-harbour/miryoku_zmk/blob/master/miryoku/miryoku_babel/miryoku_layer_alternatives.h
// https://github.com/manna-harbour/miryoku/tree/master/docs/reference

/ {
    keymap {
        compatible = "zmk,keymap";

        default_layer {
            bindings = <
                &kp Q             &kp W             &kp E                &kp R                &kp T                     &kp Y               &kp U               &kp I             &kp O             &kp P
                U_MT(LGUI, A)     U_MT(LALT, S)     U_MT(LCTRL, D)       U_MT(LSHFT, F)       &kp G                     &kp H               U_MT(LSHFT, J)      U_MT(LCTRL, K)    U_MT(LALT, L)     U_MT(LGUI, SQT)
                U_LT(U_BUTTON, Z) U_MT(RALT, X)     &kp C                &kp V                &kp B                     &kp N               &kp M               &kp COMMA         U_MT(RALT, DOT)   U_LT(U_BUTTON, SLASH)
                                                    U_LT(U_MEDIA, ESC)   U_LT(U_NAV, SPACE)   U_LT(U_MOUSE, TAB)        U_LT(U_SYM, RET)    U_LT(U_NUM, BSPC)   U_LT(U_FUN, DEL)  
             >;
            label = "Base";
        };

        nav_layer {
            bindings = <
                U_BOOT      U_NP        U_NU       U_NU       U_NA              U_RDO             U_PST             U_CPY             U_CUT             U_UND
                &kp LGUI    &kp LALT    &kp LCTRL  &kp LSHFT  U_NA              &u_caps_word      &kp LEFT          &kp DOWN          &kp UP            &kp RIGHT
                U_NA        &kp RALT    U_NU       U_NU       U_NA              &kp INS           &kp HOME          &kp PG_DN         &kp PG_UP         &kp END
                                        U_NA       U_NA       U_NA              &kp RET           &kp BSPC          &kp DEL          
             >;
            label = "Nav";
        };

        media_layer {
            bindings = <
                U_BOOT      U_NP        U_NU       U_NU       U_NA              U_NP            U_NP            U_NP            U_NP            U_NP
                &kp LGUI    &kp LALT    &kp LCTRL  &kp LSHFT  U_NA              U_NP            &kp C_PREV      &kp C_VOL_DN    &kp C_VOL_UP    &kp C_NEXT
                U_NA        &kp RALT    U_NU       U_NU       U_NA              &u_out_tog      &u_bt_sel_0     &u_bt_sel_1     &u_bt_sel_2     &u_bt_sel_3
                                        U_NA       U_NA       U_NA              &kp C_STOP      &kp C_PP        &kp C_MUTE      
             >;
            label = "Media";
        };

        num_layer {
            bindings = <
                &kp LBKT    &kp N7      &kp N8     &kp N9     &kp RBKT          U_NA    U_NU          U_NU       U_NU       U_BOOT
                &kp SEMI    &kp N4      &kp N5     &kp N6     &kp EQUAL         U_NA    &kp LSHFT     &kp LCTRL  &kp LALT   &kp LGUI
                &kp GRAVE   &kp N1      &kp N2     &kp N3     &kp BSLH          U_NA    U_NU          U_NU       &kp RALT   U_NA
                                        &kp DOT    &kp N0     &kp MINUS         U_NA    U_NA          U_NA
             >;
            label = "Num";
        };

        sym_layer {
            bindings = <
                &kp LBRC          &kp AMPS          &kp ASTRK         &kp LPAR          &kp RBRC          U_NA    U_NU       U_NU       U_NU       U_BOOT
                &kp COLON         &kp DLLR          &kp PRCNT         &kp CARET         &kp PLUS          U_NA    &kp LSHFT  &kp LCTRL  &kp LALT   &kp LGUI
                &kp TILDE         &kp EXCL          &kp AT            &kp HASH          &kp PIPE          U_NA    U_NU       U_NU       &kp RALT   U_NA
                                                    &kp LPAR          &kp RPAR          &kp UNDER         U_NA    U_NA       U_NA      
             >;
            label = "Sym";
        };

        fun_layer {
            bindings = <
                &kp F12           &kp F7            &kp F8            &kp F9            &kp PSCRN         U_NA    U_NU         U_NU       U_NU       U_BOOT
                &kp F11           &kp F4            &kp F5            &kp F6            &kp SLCK          U_NA    &kp LSHFT    &kp LCTRL  &kp LALT   &kp LGUI
                &kp F10           &kp F1            &kp F2            &kp F3            &kp PAUSE_BREAK   U_NA    U_NU         U_NU       &kp RALT   U_NA
                                                    &kp K_APP         &kp SPACE         &kp TAB           U_NA    U_NA         U_NA     
             >;
            label = "Fun";
        };
    };
};
